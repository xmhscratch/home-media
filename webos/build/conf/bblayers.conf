## webos/build/conf/bblayers.conf
```bitbake
require conf/bblayers_default.conf

BBLAYERS ?= " \
  /home/web/repos/poky/meta \
  /home/web/repos/poky/meta-poky \
  /home/web/repos/poky/meta-yocto-bsp \
  /home/web/repos/meta-openembedded/meta-oe \
  /home/web/repos/meta-openembedded/meta-python \
  /home/web/repos/meta-openembedded/meta-networking \
  /home/web/repos/meta-openembedded/meta-filesystems \
  /home/web/repos/home-media/webos/meta-chromium \
  /home/web/repos/home-media/webos/meta-hms \
  "
```

## webos/build/conf/local.conf
```bitbake
require conf/local_default.conf

MACHINE ?= "genericx86-64"

DISTRO ?= "poky-hms"

PACKAGE_CLASSES ?= "package_rpm"

EXTRA_IMAGE_FEATURES = "debug-tweaks ssh-server-dropbear"

USER_CLASSES ?= "buildstats image-mklibs image-prelink"

BB_HASH_CODEPARSER_VALS:remove = "PN=no-pn"
PACKAGECONFIG:append:pn-qemu-native = " sdl"
PACKAGECONFIG:append:pn-nativesdk-qemu = " sdl"
ASSUME_PROVIDED += "libsdl-native"

PARALLEL_MAKE = "-j 80"
ICECC_PATH = "/usr/bin/icecc"
INHERIT += "icecc"

# libav requires commercial branding
LICENSE_FLAGS_ACCEPTED = "commercial"
CHROMIUM_LOCAL_PATH = "/home/web/repos/qtwebengine-chromium/chromium"
CHROMIUM_OUT_DIR = "/home/web/repos/home-media/dist/chromium"
PACKAGECONFIG:append:pn-chromium = " component-build ozone-gbm"
IMAGE_INSTALL:append = " chromium autoconf automake binutils babeltrace bash elfutils file git gdb gcc make pkgconfig piglit rpm sshfs-fuse strace sysstat valgrind"
# GBM requires lastest version of kernel
PREFERRED_VERSION_linux-yocto = "6.6%"
CHROMIUM_EXTRA_GYP_DEFINES = "-Dwerror= -Ddcheck_always_on=1 -Dblink_asserts_always_on=1 "
```

## webos/meta-chromium/conf/layer.conf
```bitbake
# We have a conf and classes directory, add to BBPATH
BBPATH .= ":${LAYERDIR}"

# We have recipes-* directories, add to BBFILES
BBFILES += "${LAYERDIR}/recipes-*/*/*.bb \
            ${LAYERDIR}/recipes-*/*/*.bbappend"

BBLAYERS ?= " \
  /home/web/repos/meta-qt5 \
  "

BBFILE_COLLECTIONS += "meta-chromium"
BBFILE_PATTERN_meta-chromium = "^${LAYERDIR}/"
BBFILE_PRIORITY_meta-chromium = "6"

LAYERDEPENDS_meta-chromium = "core"

LAYERSERIES_COMPAT_meta-chromium = "scarthgap"
```

## webos/meta-hms/conf/distro/poky-hms.conf
```bitbake
require conf/distro/poky.conf
require conf/distro/include/gcsections.inc

DISTRO = "poky-hms"
DISTRO_NAME = "Poky Home Media"
DISTROOVERRIDES = "poky:poky-hms"
TCLIBC = "musl"

FULL_OPTIMIZATION="-Os -pipe ${DEBUG_FLAGS}"

# FIXME: consider adding a new "tiny" feature
#DISTRO_FEATURES_append = " tiny"

# Distro config is evaluated after the machine config, so we have to explicitly
# set the kernel provider to override a machine config.
PREFERRED_PROVIDER_virtual/kernel = "linux-yocto"
PREFERRED_VERSION_linux-yocto ?= "6.6%"

# We can use packagegroup-core-boot, but in the future we may need a new packagegroup-core-tiny
#POKY_DEFAULT_EXTRA_RDEPENDS += "packagegroup-core-boot"
# Drop kernel-module-af-packet from RRECOMMENDS
POKY_DEFAULT_EXTRA_RRECOMMENDS = ""

# FIXME: what should we do with this?
TCLIBCAPPEND = ""

# Disable wide char support for ncurses as we don't include it in
# in the LIBC features below.
# Leave native enable to avoid build failures
ENABLE_WIDEC = "false"
ENABLE_WIDEC:class-native = "true"

# Drop native language support. This removes the
# eglibc->bash->gettext->libc-posix-clang-wchar dependency.
USE_NLS="no"
# As we don't have native language support, don't install locales into images
IMAGE_LINGUAS = ""

# Comment out any of the lines below to disable them in the build
# DISTRO_FEATURES options:
# alsa bluetooth ext2 pcmcia usbgadget usbhost wifi nfs zeroconf pci
DISTRO_FEATURES_HMS = "alsa bluetooth nfs pci"
DISTRO_FEATURES_NET = "ipv4"
DISTRO_FEATURES_USB = "usbhost"
DISTRO_FEATURES_WIFI = "wifi"

DISTRO_FEATURES = "${DISTRO_FEATURES_HMS} \
                   ${DISTRO_FEATURES_NET} \
                   ${DISTRO_FEATURES_USB} \
                   ${DISTRO_FEATURES_USBGADGET} \
                   ${DISTRO_FEATURES_WIFI} \
                  "

DISTRO_FEATURES:class-native = "${DISTRO_FEATURES_DEFAULT} ${POKY_DEFAULT_DISTRO_FEATURES}"
DISTRO_FEATURES:class-nativesdk = "${DISTRO_FEATURES_DEFAULT} ${POKY_DEFAULT_DISTRO_FEATURES}"

# Ensure the kernel nfs server is enabled
KERNEL_FEATURES:append:pn-linux-yocto = " features/nfsd/nfsd-enable.scc"

# enable systemd for init
POKY_INIT_MANAGER:poky-hms = "systemd"
# systemd isn't suitable with musl
POKY_INIT_MANAGER:poky-hms:libc-musl = "sysvinit"

# FIXME: Consider adding "modules" to MACHINE_FEATURES and using that in
# packagegroup-core-base to select modutils-initscripts or not.  Similar with "net" and
# netbase.

# # By default we only support initramfs. We don't build live as that
# # pulls in a lot of dependencies for the live image and the installer, like
# # udev, grub, etc.  These pull in gettext, which fails to build with wide
# # character support.
# IMAGE_FSTYPES = "cpio.gz"
# QB_DEFAULT_FSTYPE = "cpio.gz"

# Drop v86d from qemu dependency list (we support serial)
# Drop grub from meta-intel BSPs
# FIXME: A different mechanism is needed here. We could define -tiny
#        variants of all compatible machines, but that leads to a lot
#        more machine configs to maintain long term.
MACHINE_ESSENTIAL_EXTRA_RDEPENDS = ""

# The mtrace script included by eglibc is a perl script. This means the system
# will build perl in case this package is installed. Since we don't care about
# this script for the purposes of tiny, remove the dependency from here.
RDEPENDS:${PN}-mtrace:pn-eglibc = ""

SKIP_RECIPE[build-appliance-image] = "not buildable with poky-hms"
SKIP_RECIPE[core-image-rt] = "not buildable with poky-hms"
SKIP_RECIPE[core-image-rt-sdk] = "not buildable with poky-hms"
SKIP_RECIPE[core-image-sato] = "not buildable with poky-hms"
SKIP_RECIPE[core-image-sato-dev] = "not buildable with poky-hms"
SKIP_RECIPE[core-image-sato-sdk] = "not buildable with poky-hms"
# SKIP_RECIPE[core-image-x11] = "not buildable with poky-hms"
# SKIP_RECIPE[core-image-weston] = "not buildable with poky-hms"

# Disable python usage in opkg-utils since it won't build with tiny config
PACKAGECONFIG:remove:pn-opkg-utils = "python"

# If shadow-base is brought into the image, logins will fail because it
# doesn't have the heuristics to work when CONFIG_MULTIUSER is unset.
PACKAGE_EXCLUDE += "shadow-base"
```
